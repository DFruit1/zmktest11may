## boards/shields/corne_left/Kconfig.defconfig
```kconfig
If SHIELD_CORNE_LEFT

config ZMK_KEYBOARD_NAME
    default "corne_left"

config ZMK_SPLIT_ROLE
    default "left"

endif
```

## boards/shields/corne_right/Kconfig.defconfig
```kconfig
If SHIELD_CORNE_RIGHT

config ZMK_KEYBOARD_NAME
    default "corne_right"

config ZMK_SPLIT_ROLE
    default "right"

endif
```

## config/west.yml
```yaml
manifest:
  remotes:
    - name: zmkfirmware
      url-base: https://github.com/zmkfirmware
    - name: DFruit1
      url-base: https://github.com/DFruit1

  projects:
    - name: zmk
      remote: zmkfirmware
      revision: master
      import: app/west.yml
    - name: corne_left
      remote: DFruit1
      revision: master
      path: boards/shields/corne_left
    - name: corne_right
      remote: DFruit1
      revision: master
      path: boards/shields/corne_right

  self:
    path: config
```
